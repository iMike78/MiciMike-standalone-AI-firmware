## sdkconfig.defaults
```kconfig
# MiciMike AI Firmware - sdkconfig defaults
# Target: ESP32-S3 with 8MB PSRAM (OPI)

# Target
CONFIG_IDF_TARGET="esp32s3"

# Flash
CONFIG_ESPTOOLPY_FLASHSIZE_16MB=y
CONFIG_ESPTOOLPY_FLASHMODE_QIO=y

# PSRAM
CONFIG_SPIRAM=y
CONFIG_SPIRAM_MODE_OCT=y
CONFIG_SPIRAM_SPEED_80M=y
CONFIG_SPIRAM_TRY_ALLOCATE_WIFI_LWIP=y

# Memory allocation
CONFIG_SPIRAM_USE_MALLOC=y
CONFIG_SPIRAM_MALLOC_ALWAYSINTERNAL=4096

# FreeRTOS
CONFIG_FREERTOS_HZ=1000
CONFIG_FREERTOS_TIMER_TASK_STACK_DEPTH=4096

# WiFi
CONFIG_ESP_WIFI_STATIC_RX_BUFFER_NUM=16
CONFIG_ESP_WIFI_DYNAMIC_RX_BUFFER_NUM=32
CONFIG_ESP_WIFI_DYNAMIC_TX_BUFFER_NUM=32

# WebSocket (provided by managed component, no Kconfig needed)

# TLS (for WSS connection)
CONFIG_ESP_TLS_USING_MBEDTLS=y
CONFIG_MBEDTLS_SSL_MAX_CONTENT_LEN=16384
CONFIG_MBEDTLS_EXTERNAL_MEM_ALLOC=y
CONFIG_MBEDTLS_DYNAMIC_BUFFER=y
CONFIG_MBEDTLS_CERTIFICATE_BUNDLE=y
CONFIG_MBEDTLS_CERTIFICATE_BUNDLE_DEFAULT_FULL=y
CONFIG_MBEDTLS_CERTIFICATE_BUNDLE_CROSS_SIGNED_VERIFY=y

# Logging
CONFIG_LOG_DEFAULT_LEVEL_INFO=y

# LWIP socket pool — must cover: WiFi, mDNS, SNTP, settings httpd (80) +
# its ~4 client slots, sendspin httpd (8928) + its 2 client slots,
# sendspin WS client (8927), OpenAI WS client, and a radio HTTP socket.
# Default 10 is far too tight; 40 leaves headroom for bursts.
CONFIG_LWIP_MAX_SOCKETS=40

# I2C
CONFIG_I2C_ISR_IRAM_SAFE=y

# Touch pad (legacy API, will migrate to new API later)
CONFIG_TOUCH_SUPPRESS_DEPRECATE_WARN=y

# I2C (legacy API, will migrate to new API later)
CONFIG_I2C_SUPPRESS_DEPRECATE_WARN=y

# Partition table (custom — 3MB app for TFLite Micro + model)
CONFIG_PARTITION_TABLE_CUSTOM=y
CONFIG_PARTITION_TABLE_CUSTOM_FILENAME="partitions.csv"
```
